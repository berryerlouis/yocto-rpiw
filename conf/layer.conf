## conf/layer.conf
```bitbake
# We have a conf and classes directory, append to BBPATH
BBPATH .= ":${LAYERDIR}"

# We have a recipes directory containing .bb and .bbappend files, add to BBFILES
BBFILES += "${LAYERDIR}/recipes*/*/*.bb \
            ${LAYERDIR}/recipes*/*/*.bbappend"

BBFILE_COLLECTIONS += "rpiw"
BBFILE_PATTERN_rpiw := "^${LAYERDIR}/"
BBFILE_PRIORITY_rpiw = "9"

LAYERSERIES_COMPAT_rpiw = "styhead walnascar"
LAYERDEPENDS_rpiw = "core"
```
